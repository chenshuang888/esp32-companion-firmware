## sdkconfig.defaults
```kconfig
# LVGL Configuration
CONFIG_LV_COLOR_DEPTH_16=y
CONFIG_LV_COLOR_16_SWAP=n

# LVGL Fonts
CONFIG_LV_FONT_MONTSERRAT_14=y
CONFIG_LV_FONT_MONTSERRAT_20=y
CONFIG_LV_FONT_MONTSERRAT_24=y
# 不再用 LVGL 自带 CJK 字库（仅 1118 字，覆盖不足），改用 Tiny TTF 运行时渲染
# CONFIG_LV_FONT_SOURCE_HAN_SANS_SC_14_CJK is not set
# CONFIG_LV_FONT_SOURCE_HAN_SANS_SC_16_CJK is not set

# Tiny TTF：运行时从嵌入的子集 TTF 渲染中文
CONFIG_LV_USE_TINY_TTF=y
CONFIG_LV_TINY_TTF_FILE_SUPPORT=n
CONFIG_LV_TINY_TTF_CACHE_GLYPH_CNT=256
CONFIG_LV_TINY_TTF_CACHE_KERNING_CNT=0

# LVGL: 用 libc malloc 代替 builtin 池，让 heap_caps 自动挑内部 RAM / PSRAM
# 小分配 (<16KB) 走内部 RAM，大分配自动落到 PSRAM
CONFIG_LV_USE_CLIB_MALLOC=y

# LVGL FS Driver: 借道 esp_littlefs 的 VFS，让 lv_image 能用 "A:/littlefs/..." 加载 .bin
# LETTER=65 = 'A'；PATH 留空 = 直接拼绝对 POSIX 路径
CONFIG_LV_USE_FS_STDIO=y
CONFIG_LV_FS_STDIO_LETTER=65
CONFIG_LV_FS_STDIO_PATH=""

# FreeRTOS Configuration
CONFIG_FREERTOS_HZ=1000

# ESP32S3 Configuration
CONFIG_ESP_DEFAULT_CPU_FREQ_MHZ_240=y

# SPI Configuration
CONFIG_SPI_MASTER_ISR_IN_IRAM=y

# I2C Configuration
CONFIG_I2C_ENABLE_DEBUG_LOG=n

# LCD Touch FT5x06
CONFIG_ESP_LCD_TOUCH_MAX_BUTTONS=1

# Memory Configuration
CONFIG_ESP_MAIN_TASK_STACK_SIZE=8192
CONFIG_FREERTOS_TIMER_TASK_STACK_DEPTH=4096

# LVGL Task Configuration - Use ESP-IDF native tick
CONFIG_LV_TICK_CUSTOM=n
CONFIG_LV_MEM_CUSTOM=n

# Bluetooth Configuration
CONFIG_BT_ENABLED=y
CONFIG_BT_NIMBLE_ENABLED=y
CONFIG_BT_NIMBLE_50_FEATURE_SUPPORT=n

# ====================================================================
# ESP32-S3 N16R8: 16MB QIO Flash + 8MB Octal PSRAM
# ====================================================================

# ---- Flash (16MB, QIO, 80MHz) ----
# N16 的 flash 是 Quad，不是 Octal。OCT_FLASH 必须保持 OFF，
# 否则会和 OCT PSRAM 一起时序冲突，典型表现为 boot 循环。
CONFIG_ESPTOOLPY_FLASHMODE_QIO=y
CONFIG_ESPTOOLPY_FLASHFREQ_80M=y
CONFIG_ESPTOOLPY_FLASHSIZE_16MB=y
CONFIG_ESPTOOLPY_FLASHSIZE="16MB"

# ---- PSRAM (R8 = 8MB Octal, 80MHz) ----
CONFIG_SPIRAM=y
CONFIG_SPIRAM_MODE_OCT=y
CONFIG_SPIRAM_TYPE_AUTO=y
CONFIG_SPIRAM_SPEED_80M=y
CONFIG_SPIRAM_BOOT_INIT=y
CONFIG_SPIRAM_IGNORE_NOTFOUND=n
CONFIG_SPIRAM_USE_MALLOC=y
CONFIG_SPIRAM_MEMTEST=y
# 小于 16KB 的分配走内部 RAM（性能），以上自动落 PSRAM
CONFIG_SPIRAM_MALLOC_ALWAYSINTERNAL=16384
# 保留 32KB 内部 RAM 给无法用 PSRAM 的场景（DMA/ISR）
CONFIG_SPIRAM_MALLOC_RESERVE_INTERNAL=32768

# ---- BLE NimBLE 堆走 PSRAM（释放内部 RAM）----
CONFIG_BT_NIMBLE_MEM_ALLOC_MODE_EXTERNAL=y

# ---- 自定义分区表（16MB 布局）----
CONFIG_PARTITION_TABLE_CUSTOM=y
CONFIG_PARTITION_TABLE_CUSTOM_FILENAME="partitions.csv"
CONFIG_PARTITION_TABLE_FILENAME="partitions.csv"
```
